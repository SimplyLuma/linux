## Documentation/devicetree/bindings/media/qcom,sm7250-camss.yaml
```yaml
# SPDX-License-Identifier: (GPL-2.0-only OR BSD-2-Clause)
%YAML 1.2
---
$id: http://devicetree.org/schemas/media/qcom,sm7250-camss.yaml#
$schema: http://devicetree.org/meta-schemas/core.yaml#

title: Qualcomm SM7250 Camera Subsystem (CAMSS)

maintainers:
  - lazybrar <211365301+lazybrar@users.noreply.github.com>

description:
  This binding describes the camera subsystem hardware found on SM7250
  Qualcomm SoCs. It includes the CSIPHY (CSI Physical layer), CSID (CSI
  Decoder) and VFE (Video Front End, IFE) blocks, which comply with the MIPI
  CSI2 protocol. Only the blocks driven by the camss driver are described;
  the image processing engines (BPS, IPE, JPEG, ...) are not.

properties:
  compatible:
    const: qcom,sm7250-camss

  reg:
    items:
      - description: Registers for CSID 0
      - description: Registers for CSID 1
      - description: Registers for CSID Lite
      - description: Registers for CSIPHY 0
      - description: Registers for CSIPHY 1
      - description: Registers for CSIPHY 2
      - description: Registers for CSIPHY 3
      - description: Registers for VFE (Video Front End) 0
      - description: Registers for VFE 1
      - description: Registers for VFE Lite

  reg-names:
    items:
      - const: csid0
      - const: csid1
      - const: csid_lite
      - const: csiphy0
      - const: csiphy1
      - const: csiphy2
      - const: csiphy3
      - const: vfe0
      - const: vfe1
      - const: vfe_lite

  clocks:
    maxItems: 22

  clock-names:
    items:
      - const: gcc_axi_hf
      - const: camnoc_axi
      - const: cpas_ahb
      - const: csiphy0
      - const: csiphy0_timer
      - const: csiphy1
      - const: csiphy1_timer
      - const: csiphy2
      - const: csiphy2_timer
      - const: csiphy3
      - const: csiphy3_timer
      - const: vfe0
      - const: vfe0_axi
      - const: vfe0_cphy_rx
      - const: vfe0_csid
      - const: vfe1
      - const: vfe1_axi
      - const: vfe1_cphy_rx
      - const: vfe1_csid
      - const: vfe_lite
      - const: vfe_lite_cphy_rx
      - const: vfe_lite_csid

  interrupts:
    maxItems: 10

  interrupt-names:
    items:
      - const: csid0
      - const: csid1
      - const: csid_lite
      - const: csiphy0
      - const: csiphy1
      - const: csiphy2
      - const: csiphy3
      - const: vfe0
      - const: vfe1
      - const: vfe_lite

  interconnects:
    maxItems: 2

  interconnect-names:
    items:
      - const: ahb
      - const: hf_0

  iommus:
    maxItems: 1
    description: Camera IFE non-protected stream

  power-domains:
    items:
      - description: IFE0 GDSC - Image Front End, Global Distributed Switch Controller.
      - description: IFE1 GDSC - Image Front End, Global Distributed Switch Controller.
      - description: Titan GDSC - Titan ISP Block, Global Distributed Switch Controller.

  power-domain-names:
    items:
      - const: ife0
      - const: ife1
      - const: top

  vdd-csiphy-0p9-supply:
    description:
      Phandle to a 0.88V regulator supply to the CSI PHYs.

  ports:
    $ref: /schemas/graph.yaml#/properties/ports

    description:
      CSI input ports.

    patternProperties:
      "^port@[0-3]$":
        $ref: /schemas/graph.yaml#/$defs/port-base
        unevaluatedProperties: false

        description:
          Input port for receiving CSI data from a CSIPHY.

        properties:
          endpoint:
            $ref: video-interfaces.yaml#
            unevaluatedProperties: false

            properties:
              data-lanes:
                minItems: 1
                maxItems: 4

              bus-type:
                enum:
                  - 4  # MEDIA_BUS_TYPE_CSI2_DPHY

            required:
              - data-lanes

required:
  - compatible
  - reg
  - reg-names
  - clocks
  - clock-names
  - interrupts
  - interrupt-names
  - iommus
  - power-domains
  - power-domain-names

additionalProperties: false

examples:
  - |
    #include <dt-bindings/clock/qcom,camcc-sm7250.h>
    #include <dt-bindings/clock/qcom,sm7250-gcc.h>
    #include <dt-bindings/interrupt-controller/arm-gic.h>

    soc {
        #address-cells = <2>;
        #size-cells = <2>;

        isp@acb3000 {
            compatible = "qcom,sm7250-camss";

            reg = <0x0 0x0acb3000 0x0 0x1000>,
                  <0x0 0x0acba000 0x0 0x1000>,
                  <0x0 0x0acc8000 0x0 0x1000>,
                  <0x0 0x0ace0000 0x0 0x2000>,
                  <0x0 0x0ace2000 0x0 0x2000>,
                  <0x0 0x0ace4000 0x0 0x2000>,
                  <0x0 0x0ace6000 0x0 0x2000>,
                  <0x0 0x0acaf000 0x0 0x5200>,
                  <0x0 0x0acb6000 0x0 0x5200>,
                  <0x0 0x0acc4000 0x0 0x4000>;
            reg-names = "csid0",
                        "csid1",
                        "csid_lite",
                        "csiphy0",
                        "csiphy1",
                        "csiphy2",
                        "csiphy3",
                        "vfe0",
                        "vfe1",
                        "vfe_lite";

            clocks = <&gcc GCC_CAMERA_HF_AXI_CLK>,
                     <&camcc CAM_CC_CAMNOC_AXI_CLK>,
                     <&camcc CAM_CC_CPAS_AHB_CLK>,
                     <&camcc CAM_CC_CSIPHY0_CLK>,
                     <&camcc CAM_CC_CSI0PHYTIMER_CLK>,
                     <&camcc CAM_CC_CSIPHY1_CLK>,
                     <&camcc CAM_CC_CSI1PHYTIMER_CLK>,
                     <&camcc CAM_CC_CSIPHY2_CLK>,
                     <&camcc CAM_CC_CSI2PHYTIMER_CLK>,
                     <&camcc CAM_CC_CSIPHY3_CLK>,
                     <&camcc CAM_CC_CSI3PHYTIMER_CLK>,
                     <&camcc CAM_CC_IFE_0_CLK>,
                     <&camcc CAM_CC_IFE_0_AXI_CLK>,
                     <&camcc CAM_CC_IFE_0_CPHY_RX_CLK>,
                     <&camcc CAM_CC_IFE_0_CSID_CLK>,
                     <&camcc CAM_CC_IFE_1_CLK>,
                     <&camcc CAM_CC_IFE_1_AXI_CLK>,
                     <&camcc CAM_CC_IFE_1_CPHY_RX_CLK>,
                     <&camcc CAM_CC_IFE_1_CSID_CLK>,
                     <&camcc CAM_CC_IFE_LITE_CLK>,
                     <&camcc CAM_CC_IFE_LITE_CPHY_RX_CLK>,
                     <&camcc CAM_CC_IFE_LITE_CSID_CLK>;
            clock-names = "gcc_axi_hf",
                          "camnoc_axi",
                          "cpas_ahb",
                          "csiphy0",
                          "csiphy0_timer",
                          "csiphy1",
                          "csiphy1_timer",
                          "csiphy2",
                          "csiphy2_timer",
                          "csiphy3",
                          "csiphy3_timer",
                          "vfe0",
                          "vfe0_axi",
                          "vfe0_cphy_rx",
                          "vfe0_csid",
                          "vfe1",
                          "vfe1_axi",
                          "vfe1_cphy_rx",
                          "vfe1_csid",
                          "vfe_lite",
                          "vfe_lite_cphy_rx",
                          "vfe_lite_csid";

            interrupts = <GIC_SPI 464 IRQ_TYPE_EDGE_RISING>,
                         <GIC_SPI 466 IRQ_TYPE_EDGE_RISING>,
                         <GIC_SPI 468 IRQ_TYPE_EDGE_RISING>,
                         <GIC_SPI 477 IRQ_TYPE_EDGE_RISING>,
                         <GIC_SPI 478 IRQ_TYPE_EDGE_RISING>,
                         <GIC_SPI 479 IRQ_TYPE_EDGE_RISING>,
                         <GIC_SPI 448 IRQ_TYPE_EDGE_RISING>,
                         <GIC_SPI 465 IRQ_TYPE_EDGE_RISING>,
                         <GIC_SPI 467 IRQ_TYPE_EDGE_RISING>,
                         <GIC_SPI 469 IRQ_TYPE_EDGE_RISING>;
            interrupt-names = "csid0",
                              "csid1",
                              "csid_lite",
                              "csiphy0",
                              "csiphy1",
                              "csiphy2",
                              "csiphy3",
                              "vfe0",
                              "vfe1",
                              "vfe_lite";

            iommus = <&apps_smmu 0x800 0x5e0>;

            power-domains = <&camcc IFE_0_GDSC>,
                            <&camcc IFE_1_GDSC>,
                            <&camcc TITAN_TOP_GDSC>;
            power-domain-names = "ife0",
                                 "ife1",
                                 "top";

            vdd-csiphy-0p9-supply = <&vreg_l5a_0p88>;

            ports {
                #address-cells = <1>;
                #size-cells = <0>;

                port@3 {
                    reg = <3>;

                    csiphy3_ep: endpoint {
                        data-lanes = <0 1 2 3>;
                        remote-endpoint = <&sensor_ep>;
                    };
                };
            };
        };
    };
```

## Documentation/devicetree/bindings/media/qcom,sm7250-venus.yaml
```yaml
# SPDX-License-Identifier: (GPL-2.0 OR BSD-2-Clause)
%YAML 1.2
---
$id: http://devicetree.org/schemas/media/qcom,sm7250-venus.yaml#
$schema: http://devicetree.org/meta-schemas/core.yaml#

title: Qualcomm SM7250 Venus video encode and decode accelerators

maintainers:
  - Sreeshankar K <sreeshankar0910@gmail.com>

description: |
  The Venus IP is a video encode and decode accelerator present
  on Qualcomm platforms

allOf:
  - $ref: qcom,venus-common.yaml#

properties:
  compatible:
    const: qcom,sm7250-venus

  power-domains:
    minItems: 2
    maxItems: 3

  power-domain-names:
    minItems: 2
    items:
      - const: venus
      - const: vcodec0
      - const: cx

  clocks:
    maxItems: 5

  clock-names:
    items:
      - const: core
      - const: iface
      - const: bus
      - const: vcodec0_core
      - const: vcodec0_bus

  iommus:
    maxItems: 2

  memory-region:
    maxItems: 1

  interconnects:
    maxItems: 2

  interconnect-names:
    items:
      - const: video-mem
      - const: cpu-cfg

  operating-points-v2: true
  opp-table:
    type: object

  video-decoder:
    type: object

    properties:
      compatible:
        const: venus-decoder

    required:
      - compatible

    deprecated: true
    additionalProperties: false

  video-encoder:
    type: object

    properties:
      compatible:
        const: venus-encoder

    required:
      - compatible

    deprecated: true
    additionalProperties: false

  video-firmware:
    type: object
    additionalProperties: false

    description: |
      Firmware subnode is needed when the platform does not
      have TrustZone.

    properties:
      iommus:
        maxItems: 1

    required:
      - iommus

required:
  - compatible
  - power-domain-names
  - iommus

unevaluatedProperties: false

examples:
  - |
    #include <dt-bindings/interrupt-controller/arm-gic.h>
    #include <dt-bindings/clock/qcom,sm7250-videocc.h>
    #include <dt-bindings/power/qcom,rpmhpd.h>

    video-codec@aa00000 {
        compatible = "qcom,sm7250-venus";
        reg = <0x0aa00000 0xff000>;
        interrupts = <GIC_SPI 174 IRQ_TYPE_LEVEL_HIGH>;
        power-domains = <&videocc MVSC_GDSC>,
                        <&videocc MVS0_GDSC>,
                        <&rpmhpd RPMHPD_CX>;
        power-domain-names = "venus", "vcodec0", "cx";
        operating-points-v2 = <&venus_opp_table>;
        clocks = <&videocc VIDEOCC_MVSC_CORE_CLK>,
                 <&videocc VIDEOCC_VENUS_AHB_CLK>,
                 <&videocc VIDEOCC_MVSC_CTL_AXI_CLK>,
                 <&videocc VIDEOCC_MVS0_CORE_CLK>,
                 <&videocc VIDEOCC_MVS0_AXI_CLK>;
        clock-names = "core", "iface", "bus",
                      "vcodec0_core", "vcodec0_bus";
        iommus = <&apps_smmu 0x1380 0x60>,
                 <&apps_smmu 0x1360 0x0>;
        memory-region = <&video_mem>;

        venus_opp_table: opp-table {
            compatible = "operating-points-v2";

            opp-240000000 {
                opp-hz = /bits/ 64 <240000000>;
                required-opps = <&rpmhpd_opp_low_svs>;
            };
        };
    };
```

## Documentation/devicetree/bindings/power/supply/qcom,pm7250b-charger.yaml
```yaml
# SPDX-License-Identifier: GPL-2.0-only OR BSD-2-Clause
%YAML 1.2
---
$id: http://devicetree.org/schemas/power/supply/qcom,pm7250b-charger.yaml#
$schema: http://devicetree.org/meta-schemas/core.yaml#

title: Qualcomm PM7250B SMB5 battery charger (status and charge inhibit)

maintainers:
  - Claude <noreply@anthropic.com>

description:
  The SMB5 switch-mode charger inside the PM7250B PMIC. This binding covers a
  minimal driver that reports charger and USB input state and can stop or
  resume charging. It never programs voltage or current limits.

properties:
  compatible:
    const: qcom,pm7250b-charger

  reg:
    maxItems: 1
    description: Base address of the CHGR peripheral (0x1000)

required:
  - compatible
  - reg

allOf:
  - $ref: power-supply.yaml#

unevaluatedProperties: false

examples:
  - |
    pmic {
        #address-cells = <1>;
        #size-cells = <0>;

        charger@1000 {
            compatible = "qcom,pm7250b-charger";
            reg = <0x1000>;
        };
    };
```

## Documentation/devicetree/bindings/sound/nxp,tfa9874.yaml
```yaml
# SPDX-License-Identifier: (GPL-2.0-only OR BSD-2-Clause)
%YAML 1.2
---
$id: http://devicetree.org/schemas/sound/nxp,tfa9874.yaml#
$schema: http://devicetree.org/meta-schemas/core.yaml#

title: NXP/Goodix TFA9874 (TFA2) Audio Amplifier

maintainers:
  - lazybrar <211365301+lazybrar@users.noreply.github.com>

description:
  Mono class-D speaker amplifier with an I2C control interface and an I2S/TDM
  audio input. The built-in CoolFlux DSP is not used by the driver.

allOf:
  - $ref: dai-common.yaml#

properties:
  compatible:
    const: nxp,tfa9874

  reg:
    maxItems: 1

  '#sound-dai-cells':
    const: 0

  reset-gpios:
    description:
      GPIO connected to the reset line of the amplifier. The driver asserts
      it on probe and releases it after 5 ms.
    maxItems: 1

  sound-name-prefix: true

  vddd-supply:
    description: regulator phandle for the VDDD (1.8 V digital) power supply.

required:
  - compatible
  - reg
  - '#sound-dai-cells'
  - vddd-supply

additionalProperties: false

examples:
  - |
    #include <dt-bindings/gpio/gpio.h>
    i2c {
      #address-cells = <1>;
      #size-cells = <0>;

      audio-codec@34 {
        compatible = "nxp,tfa9874";
        reg = <0x34>;
        reset-gpios = <&tlmm 125 GPIO_ACTIVE_LOW>;
        vddd-supply = <&vreg_s4a_1p8>;
        #sound-dai-cells = <0>;
      };
    };
```
