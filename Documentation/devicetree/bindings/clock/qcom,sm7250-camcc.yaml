## Documentation/devicetree/bindings/clock/qcom,sm7250-camcc.yaml
```yaml
# SPDX-License-Identifier: (GPL-2.0-only OR BSD-2-Clause)
%YAML 1.2
---
$id: http://devicetree.org/schemas/clock/qcom,sm7250-camcc.yaml#
$schema: http://devicetree.org/meta-schemas/core.yaml#

title: Qualcomm Camera Clock & Reset Controller on SM7250

maintainers:
  - lazybrar <211365301+lazybrar@users.noreply.github.com>

description: |
  Qualcomm camera clock control module provides the clocks and power
  domains on SM7250.

  See also: include/dt-bindings/clock/qcom,camcc-sm7250.h

allOf:
  - $ref: qcom,gcc.yaml#

properties:
  compatible:
    const: qcom,sm7250-camcc

  clocks:
    items:
      - description: AHB
      - description: Board XO source
      - description: Board active XO source
      - description: Sleep clock source

  clock-names:
    items:
      - const: iface
      - const: bi_tcxo
      - const: bi_tcxo_ao
      - const: sleep_clk

  power-domains:
    items:
      - description: CX power domain

  reg:
    maxItems: 1

  required-opps:
    maxItems: 1
    description:
      OPP node describing required CX performance point.

required:
  - compatible
  - clocks
  - clock-names
  - power-domains
  - required-opps

unevaluatedProperties: false

examples:
  - |
    #include <dt-bindings/clock/qcom,rpmh.h>
    #include <dt-bindings/clock/qcom,sm7250-gcc.h>
    #include <dt-bindings/power/qcom,rpmhpd.h>
    clock-controller@ad00000 {
      compatible = "qcom,sm7250-camcc";
      reg = <0x0ad00000 0x10000>;
      clocks = <&gcc GCC_CAMERA_AHB_CLK>,
               <&rpmhcc RPMH_CXO_CLK>,
               <&rpmhcc RPMH_CXO_CLK_A>,
               <&sleep_clk>;
      clock-names = "iface", "bi_tcxo", "bi_tcxo_ao", "sleep_clk";
      power-domains = <&rpmhpd RPMHPD_CX>;
      required-opps = <&rpmhpd_opp_low_svs>;
      #clock-cells = <1>;
      #power-domain-cells = <1>;
    };
...
```

## Documentation/devicetree/bindings/clock/qcom,sm7250-videocc.yaml
```yaml
# SPDX-License-Identifier: (GPL-2.0-only OR BSD-2-Clause)
%YAML 1.2
---
$id: http://devicetree.org/schemas/clock/qcom,sm7250-videocc.yaml#
$schema: http://devicetree.org/meta-schemas/core.yaml#

title: Qualcomm Video Clock & Reset Controller on SM7250

maintainers:
  - Sreeshankar K <sreeshankar0910@gmail.com>

description: |
  Qualcomm video clock control module provides the clocks, resets and power
  domains on SM7250.

  See also: include/dt-bindings/clock/qcom,sm7250-videocc.h

properties:
  compatible:
    const: qcom,sm7250-videocc

  clocks:
    items:
      - description: Board XO source
      - description: Board Always On XO source
      - description: Sleep clock source

  power-domains:
    maxItems: 1
    description:
      CX power domain.

required:
  - compatible
  - clocks
  - power-domains

allOf:
  - $ref: qcom,gcc.yaml#

unevaluatedProperties: false

examples:
  - |
    #include <dt-bindings/clock/qcom,rpmh.h>
    #include <dt-bindings/power/qcom,rpmhpd.h>
    clock-controller@ab00000 {
      compatible = "qcom,sm7250-videocc";
      reg = <0x0ab00000 0x10000>;
      clocks = <&rpmhcc RPMH_CXO_CLK>,
               <&rpmhcc RPMH_CXO_CLK_A>,
               <&sleep_clk>;
      power-domains = <&rpmhpd RPMHPD_CX>;
      #clock-cells = <1>;
      #reset-cells = <1>;
      #power-domain-cells = <1>;
    };
...
```

## Documentation/devicetree/bindings/input/awinic,aw8697.yaml
```yaml
# SPDX-License-Identifier: (GPL-2.0-only OR BSD-2-Clause)
%YAML 1.2
---
$id: http://devicetree.org/schemas/input/awinic,aw8697.yaml#
$schema: http://devicetree.org/meta-schemas/core.yaml#

title: Awinic AW8697 haptic driver for LRA motors

maintainers:
  - lazybrar <211365301+lazybrar@users.noreply.github.com>

properties:
  compatible:
    const: awinic,aw8697

  reg:
    maxItems: 1

  reset-gpios:
    description: Active-low reset (RSTN) pin
    maxItems: 1

  interrupts:
    description: Interrupt line (INTN), currently not used by the driver
    maxItems: 1

required:
  - compatible
  - reg

additionalProperties: false

examples:
  - |
    #include <dt-bindings/gpio/gpio.h>
    #include <dt-bindings/interrupt-controller/irq.h>

    i2c {
        #address-cells = <1>;
        #size-cells = <0>;

        haptics@5a {
            compatible = "awinic,aw8697";
            reg = <0x5a>;
            reset-gpios = <&tlmm 71 GPIO_ACTIVE_LOW>;
            interrupts-extended = <&tlmm 70 IRQ_TYPE_LEVEL_LOW>;
        };
    };
```

## Documentation/devicetree/bindings/input/touchscreen/goodix,gt9886.yaml
```yaml
# SPDX-License-Identifier: (GPL-2.0-only OR BSD-2-Clause)
%YAML 1.2
---
$id: http://devicetree.org/schemas/input/touchscreen/goodix,gt9886.yaml#
$schema: http://devicetree.org/meta-schemas/core.yaml#

title: Goodix GT9886 touchscreen controller

maintainers:
  - lazybrar <211365301+lazybrar@users.noreply.github.com>

allOf:
  - $ref: touchscreen.yaml#

properties:
  compatible:
    const: goodix,gt9886

  reg:
    maxItems: 1

  interrupts:
    maxItems: 1

  reset-gpios:
    maxItems: 1

  vdd-supply:
    description: Analog supply (2.8 V)

  vddio-supply:
    description: I/O supply (1.8 V)

required:
  - compatible
  - reg
  - interrupts
  - reset-gpios
  - vdd-supply
  - vddio-supply
  - touchscreen-size-x
  - touchscreen-size-y

unevaluatedProperties: false

examples:
  - |
    #include <dt-bindings/gpio/gpio.h>
    #include <dt-bindings/interrupt-controller/irq.h>

    i2c {
        #address-cells = <1>;
        #size-cells = <0>;

        touchscreen@5d {
            compatible = "goodix,gt9886";
            reg = <0x5d>;
            interrupt-parent = <&tlmm>;
            interrupts = <9 IRQ_TYPE_EDGE_FALLING>;
            reset-gpios = <&tlmm 8 GPIO_ACTIVE_LOW>;
            vdd-supply = <&vreg_l13a>;
            vddio-supply = <&vreg_l1c>;
            touchscreen-size-x = <1080>;
            touchscreen-size-y = <2400>;
        };
    };
...
```

## Documentation/devicetree/bindings/interconnect/qcom,sm7250-rpmh.yaml
```yaml
# SPDX-License-Identifier: (GPL-2.0-only OR BSD-2-Clause)
%YAML 1.2
---
$id: http://devicetree.org/schemas/interconnect/qcom,sm7250-rpmh.yaml#
$schema: http://devicetree.org/meta-schemas/core.yaml#

title: Qualcomm RPMh Network-On-Chip Interconnect on SM7250

maintainers:
  - lazybrar <211365301+lazybrar@users.noreply.github.com>

description: |
  RPMh interconnect providers support system bandwidth requirements through
  RPMh hardware accelerators known as Bus Clock Manager (BCM). The provider is
  able to communicate with the BCM through the Resource State Coordinator (RSC)
  associated with each execution environment. Provider nodes must point to at
  least one RPMh device child node pertaining to their RSC and each provider
  can map to multiple RPMh resources.

  See also: include/dt-bindings/interconnect/qcom,sm7250-rpmh.h

properties:
  compatible:
    enum:
      - qcom,sm7250-aggre1-noc
      - qcom,sm7250-aggre2-noc
      - qcom,sm7250-config-noc
      - qcom,sm7250-dc-noc
      - qcom,sm7250-gem-noc
      - qcom,sm7250-mmss-noc
      - qcom,sm7250-npu-noc
      - qcom,sm7250-system-noc

  reg:
    maxItems: 1

# Child node's properties
patternProperties:
  '^interconnect-[a-z0-9\-]+$':
    type: object
    description:
      The interconnect providers do not have a separate QoS register space,
      but share parent's space.
    $ref: qcom,rpmh-common.yaml#

    properties:
      compatible:
        enum:
          - qcom,sm7250-compute-noc
          - qcom,sm7250-ipa-virt
          - qcom,sm7250-mc-virt
          - qcom,sm7250-qup-virt

    required:
      - compatible

    unevaluatedProperties: false

required:
  - compatible
  - reg

allOf:
  - $ref: qcom,rpmh-common.yaml#

unevaluatedProperties: false

examples:
  - |
    #include <dt-bindings/interconnect/qcom,sm7250-rpmh.h>

    interconnect@1620000 {
        compatible = "qcom,sm7250-system-noc";
        reg = <0x01620000 0x19200>;
        #interconnect-cells = <2>;
        qcom,bcm-voters = <&apps_bcm_voter>;

        interconnect-ipa-virt {
            compatible = "qcom,sm7250-ipa-virt";
            #interconnect-cells = <2>;
            qcom,bcm-voters = <&apps_bcm_voter>;
        };

        interconnect-qup-virt {
            compatible = "qcom,sm7250-qup-virt";
            #interconnect-cells = <2>;
            qcom,bcm-voters = <&apps_bcm_voter>;
        };
    };

    interconnect@9680000 {
        compatible = "qcom,sm7250-gem-noc";
        reg = <0x09680000 0x3e200>;
        #interconnect-cells = <2>;
        qcom,bcm-voters = <&apps_bcm_voter>;

        interconnect-mc-virt {
            compatible = "qcom,sm7250-mc-virt";
            #interconnect-cells = <2>;
            qcom,bcm-voters = <&apps_bcm_voter>;
        };
    };
```
