## Documentation/devicetree/bindings/media/mediatek/mediatek,mt6878-seninf-camsv.yaml
```yaml
# SPDX-License-Identifier: (GPL-2.0-only OR BSD-2-Clause)
%YAML 1.2
---
$id: http://devicetree.org/schemas/media/mediatek/mediatek,mt6878-seninf-camsv.yaml#
$schema: http://devicetree.org/meta-schemas/core.yaml#

title: MediaTek MT6878 seninf + CAMSV raw capture

maintainers:
  - Project Luma <builds@project-luma.local>

description:
  The CSI-2 receiver (seninf, CSI PHY 3.1) feeding a CAMSV DMA engine, used
  for raw Bayer capture without the ISP. CAMSV writes through the MM M4U.

properties:
  compatible:
    const: mediatek,mt6878-seninf-camsv

  reg:
    items:
      - description: seninf top, SENINF blocks, muxes and cammux
      - description: CSI PHYs and CSI-2 MACs
      - description: camsys_main
      - description: CAMSV central, outer and inner pages
      - description: CAMSV DMA, outer and inner pages
      - description: CAMSV command queue
      - description: camsys_mraw
      - description: cam_vcore

  reg-names:
    items:
      - const: seninf
      - const: csi
      - const: camsys
      - const: camsv
      - const: camsv-dma
      - const: camsv-cq
      - const: camsys-mraw
      - const: cam-vcore

  interrupts:
    maxItems: 1
    description: CAMSV frame done

  power-domains:
    items:
      - description: CAM_MAIN
      - description: CSI_RX

  ports:
    $ref: /schemas/graph.yaml#/properties/ports
    description:
      One CSI-2 input per CSI port; port@N is CSI port N, used as a 4D1C
      port (PHY A and B together). One sensor streams at a time.

    patternProperties:
      "^port@[0-2]$":
        $ref: /schemas/graph.yaml#/$defs/port-base
        unevaluatedProperties: false

        properties:
          endpoint:
            $ref: /schemas/media/video-interfaces.yaml#
            unevaluatedProperties: false

            properties:
              bus-type:
                enum:
                  - 1  # MEDIA_BUS_TYPE_CSI2_CPHY, three trios
                  - 4  # MEDIA_BUS_TYPE_CSI2_DPHY, four data lanes
              data-lanes:
                minItems: 3
                maxItems: 4

            required:
              - bus-type
              - data-lanes

required:
  - compatible
  - reg
  - reg-names
  - interrupts
  - power-domains
  - ports

additionalProperties: false

examples:
  - |
    #include <dt-bindings/interrupt-controller/arm-gic.h>
    #include <dt-bindings/power/mediatek,mt6878-power.h>

    camera-capture@1a00e000 {
        compatible = "mediatek,mt6878-seninf-camsv";
        reg = <0x1a00e000 0x18000>, <0x11c80000 0x30000>,
              <0x1a000000 0x1000>, <0x1a101000 0x9000>,
              <0x1a111000 0x9000>, <0x1a121000 0x1000>,
              <0x1a170000 0x1000>, <0x1b204000 0x1000>;
        reg-names = "seninf", "csi", "camsys", "camsv", "camsv-dma",
                    "camsv-cq", "camsys-mraw", "cam-vcore";
        interrupts = <GIC_SPI 654 IRQ_TYPE_LEVEL_HIGH 0>;
        power-domains = <&spm MT6878_POWER_DOMAIN_CAM_MAIN>,
                        <&spm MT6878_POWER_DOMAIN_CSI_RX>;

        ports {
            #address-cells = <1>;
            #size-cells = <0>;

            port@0 {
                reg = <0>;

                endpoint {
                    remote-endpoint = <&front_sensor_out>;
                    bus-type = <4>;
                    data-lanes = <1 2 3 4>;
                };
            };

            port@2 {
                reg = <2>;

                endpoint {
                    remote-endpoint = <&rear_sensor_out>;
                    bus-type = <1>;
                    data-lanes = <1 2 3>;
                };
            };
        };
    };
```

## arch/arm64/Kconfig.debug
```kconfig
# SPDX-License-Identifier: GPL-2.0-only

config PID_IN_CONTEXTIDR
	bool "Write the current PID to the CONTEXTIDR register"
	help
	  Enabling this option causes the kernel to write the current PID to
	  the CONTEXTIDR register, at the expense of some additional
	  instructions during context switch. Say Y here only if you are
	  planning to use hardware trace tools with this kernel.

config DEBUG_EFI
	depends on EFI && DEBUG_INFO
	bool "UEFI debugging"
	help
	  Enable this option to include EFI specific debugging features into
	  the kernel that are only useful when using a debug build of the
	  UEFI firmware

config TITAN2E_BUILTIN_DTB
	bool "Unihertz Titan 2 Elite: boot with a built-in device tree"
	help
	  Ignore the device tree passed by the vendor bootloader and use the
	  mainline Titan 2 Elite tree linked into the kernel. Bring-up only.

config TITAN2E_BUILTIN_DTB_PATH
	string "Path to the built-in device tree blob"
	depends on TITAN2E_BUILTIN_DTB

config TITAN2E_BRINGUP_LED
	bool "Unihertz Titan 2 Elite bring-up checkpoints on the keypad backlight"
	help
	  Debug aid without UART: drive the keypad backlight (GPIO21 at
	  0x10005000) at kernel entry, end of start_kernel and after the
	  initcalls. Never enable outside bring-up.

config ARM64_RELOC_TEST
	depends on m
	tristate "Relocation testing module"

source "drivers/hwtracing/coresight/Kconfig"
```

## drivers/input/finger/Kconfig
```kconfig
# SPDX-License-Identifier: GPL-2.0-only
#
# Fingerprint driver configuration
#
menuconfig INPUT_FINGERPRINT
	bool "Fingerprint"
	default n
	depends on OF && GPIOLIB
	help
	  Say Y here to expose fingerprint sensor drivers. Authentication also
	  requires a reviewed userspace backend and secure matching policy.

	  If unsure, say N.

if INPUT_FINGERPRINT

source "drivers/input/finger/focal_finger/Kconfig"

endif
```

## drivers/input/finger/focal_finger/Kconfig
```kconfig
# SPDX-License-Identifier: GPL-2.0-only
#
# Focaltek Fingerprint driver configuration
#

config FINGER_FOCAL
	tristate "FINGER FOCAL fingerprint"
	depends on INPUT_FINGERPRINT
	help
	  Say Y here if you have a FINGER FOCAL fingerprint and want to enable
	  its normal-world power, reset, and interrupt control shim.

	  If unsure, say N.

	  To compile this driver as a module, choose M here: the
	  module will be called focaltech_fp.
```

## drivers/media/platform/mediatek/camsv/Kconfig
```kconfig
# SPDX-License-Identifier: GPL-2.0-only
config VIDEO_MT6878_CAM_M4U
	tristate
	depends on ARCH_MEDIATEK || COMPILE_TEST
	depends on ARM64 && IOMMU_IO_PGTABLE_ARMV7S

config VIDEO_MTK_SENINF_CAMSV
	tristate "MediaTek MT6878 seninf + CAMSV raw capture"
	depends on ARCH_MEDIATEK || COMPILE_TEST
	depends on ARM64 && IOMMU_IO_PGTABLE_ARMV7S
	depends on VIDEO_DEV && OF && PM
	select MEDIA_CONTROLLER
	select VIDEO_V4L2_SUBDEV_API
	select V4L2_FWNODE
	select VIDEOBUF2_DMA_SG
	select VIDEO_MT6878_CAM_M4U
	help
	  Raw Bayer capture on MediaTek MT6878: the CSI-2 receiver (seninf)
	  feeds a CAMSV DMA engine that writes frames through the MM M4U,
	  without the ISP.

	  To compile this driver as a module, choose M here: the module will
	  be called mtk-seninf-camsv.
```
